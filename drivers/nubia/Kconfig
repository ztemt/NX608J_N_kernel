## drivers/nubia/Kconfig
```kconfig
#
# Nubia drivers configuration
#

#menuconfig NUBIA_DRIVERS
menu "nubia drivers"

config NUBIA_DRIVERS
	bool "NUBIA DRIVERS"
	default n
	help
	  Say Y here if you want to enable NUBIA DRIVERS
	  If unsure, say N.

comment "Nubia Device Drivers"

if NUBIA_DRIVERS
# Add nubia drivers configuration here

config NUBIA_NFC
	bool "NUBIA_NFC"
	default n
	help
	 Say Y here if you have enable NUBIA_NFC
	 IF  unsure ,say N
config NUBIA_HW_VERSION
        bool "NUBIA HW VERSION"
        default n
        help
          Say Y here if you have enable NUBIA_HW_VERSION
          IF  unsure ,say N
source "drivers/nubia/hw_version/Kconfig"
if NUBIA_NFC
source "drivers/nubia/nfc/Kconfig"
endif

config NUBIA_SENSORS
	bool "NUBIA_SENSORS"
	depends on NUBIA_DRIVERS
	default n
	help
	  Say Y here if you don't want to enable NUBIA_SENSORS
	  
if NUBIA_SENSORS
source drivers/nubia/sensors/Kconfig
endif

config NUBIA_TOUCHSCREENS
	bool "NUBIA_TOUCHSCREENS"
	depends on NUBIA_DRIVERS
	default n
	help
	  Say Y here if you want to enable NUBIA_TOUCHSCREENS
	  If unsure, say N.

if NUBIA_TOUCHSCREENS
source "drivers/nubia/touch/Kconfig"
endif

config NUBIA_FINGERPRINT
	bool "NUBIA_FINGERPRINT"
	depends on NUBIA_DRIVERS
	default n
	help
	  Say Y here if you want to enable NUBIA_FINGERPRINT
	  If unsure, say N.
if NUBIA_FINGERPRINT
source "drivers/nubia/fingerprint/Kconfig"
endif

endif

endmenu
```

## drivers/nubia/fingerprint/Kconfig
```kconfig
################################################# FINGER_PRINTER START
config  NUBIA_SENSORS_FP
	tristate "NUBIA FP DEVICE"
	default n

if NUBIA_SENSORS_FP

config NUBIA_FP_AUTODETECT
	tristate "nubia fingerprint autodetect"
	depends on NUBIA_SENSORS_FP
	default n
	help
	  If you say yes here you, will enable fingerprint
	  autodetect function.

################################################# FINGER_PRINTER_GF3258 START
source drivers/nubia/fingerprint/gf3258/Kconfig
choice
        prompt "choose the GF3258 device style"
        depends on NUBIA_SENSORS_FP_GF3258
		default NUBIA_SENSORS_FP_GF3258_PLATFORM
		help
		  GF3258 need to select the work style

config NUBIA_SENSORS_FP_GF3258_SPI
        bool "GF3258 work as SPI device"
        help
          If you want GF3258 work as SPI device, select it.

config NUBIA_SENSORS_FP_GF3258_PLATFORM
        bool "GF3258 work as PLATFORM device"
        help
          If you want GF3258 work as PLATFORM device, select it.
endchoice
################################################# FINGER_PRINTER_GF3258 END
################################################# FINGER_PRINTER_SUNWAVE START
source drivers/nubia/fingerprint/sunwave_fp/Kconfig
################################################# FINGER_PRINTER_SUNWAVE END

endif
```

## drivers/nubia/fingerprint/gf3258/Kconfig
```kconfig
config NUBIA_SENSORS_FP_GF3258
        tristate "nubia sensors fp gf3258"
        depends on NUBIA_SENSORS_FP
        default n
        help
          This is the main file for fingerprint driver for gf3258.
          Say Y here if you have a gf3258 fingerprint connected
          to your system.
```

## drivers/nubia/hw_version/Kconfig
```kconfig
#
#config for hw version,author gaokuan.
#

config NUBIA_HW_VERSION_DEBUG
        bool "NUBIA HW VERSION DEBUG"
        depends on NUBIA_HW_VERSION
        default n
        help
          NUBIA HW VERSION DEBUG

config NUBIA_HW_VER_BY_ADC
        bool "NUBIA HW VER BY ADC"
        depends on NUBIA_HW_VERSION
        default n
        help
          NUBIA HW VER BY ADC

config NUBIA_HW_CONFIG_BY_GPIO
        bool "NUBIA HW CONFIG BY GPIO"
        depends on NUBIA_HW_VERSION
        default n
        help
          NUBIA HW CONFIG BY GPIO

config NUBIA_HW_CPU_SERIAL_NUM
        bool "NUBIA HW CPU SERIAL NUM"
        depends on NUBIA_HW_VERSION
        default y
        help
          NUBIA HW CPU SERIAL NUM

config NUBIA_HW_CPU_SERIAL_NUM_MSM8952
        bool "NUBIA_HW_CPU_SERIAL_NUM_MSM8952"
        depends on NUBIA_HW_CPU_SERIAL_NUM
        default n
        help
          NUBIA HW CPU SERIAL NUM MSM8952
```

## drivers/nubia/touch/Kconfig
```kconfig
menu "nubia driver touchscreens"

config NUBIA_TOUCHSCREEN_SYNAPTICS_DSX_2_7_0
        bool "config nubia touchscreens synaptics dsx v2.7.0"
        default n
        help
          Say Y here if you have a nubia touchscreen synaptics dsx connected
          to your system.
	  If unsure, say N.

if NUBIA_TOUCHSCREEN_SYNAPTICS_DSX_2_7_0
source "drivers/nubia/touch/synaptics_dsx_v2.7.0/Kconfig"
endif

config NUBIA_TOUCHSCREEN_NT36XXX
        bool "config nubia touchscreens nt36xxx"
        default n
        help
          Say Y here if you have a nubia touchscreen nt36xxx connected
          to your system.
	  If unsure, say N.

if NUBIA_TOUCHSCREEN_NT36XXX
source "drivers/nubia/touch/nt36xxx/Kconfig"
endif


endmenu
```
