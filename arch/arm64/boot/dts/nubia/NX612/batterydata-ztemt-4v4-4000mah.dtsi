/* Copyright (c) 2013-2014, The Linux Foundation. All rights reserved.
 *
 * This program is free software; you can redistribute it and/or modify
 * it under the terms of the GNU General Public License version 2 and
 * only version 2 as published by the Free Software Foundation.
 *
 * This program is distributed in the hope that it will be useful,
 * but WITHOUT ANY WARRANTY; without even the implied warranty of
 * MERCHANTABILITY or FITNESS FOR A PARTICULAR PURPOSE.  See the
 * GNU General Public License for more details.
 */

//zte_nx508j_2850mah_averaged_masterslave_dec10th2014


qcom,ztemt-batterydata  {
	qcom,fcc-mah = <4000>;/*zte added*/
	qcom,nom-batt-capacity-mah = <4000>;
	qcom,default-rbatt-mohm = <128>;/*zte added*/
	qcom,max-voltage-uv = <4400000>;
	qcom,rbatt-capacitive-mohm = <50>;/*zte added*/
	qcom,v-cutoff-uv = <3400000>;/*zte added*/
	qcom,chg-term-ua = <200000>;/*zte added*/
	qcom,batt-id-kohm = <15>;
	qcom,battery-beta = <4050>;
	qcom,chg-rslow-comp-c1 = <3208721>;
	qcom,chg-rslow-comp-c2 = <4450287>;
	qcom,chg-rs-to-rslow = <983446>;
	qcom,chg-rslow-comp-thr = <0xA3>;
	qcom,checksum = <0x5E3D>;
	qcom,gui-version = "PMI8950GUI - 2.0.0.16";
	qcom,battery-type = "ztemt_atl_4000mah";

	qcom,fg-profile-data = [
		 07 88 16 7E 
		 C3 81 05 7C 
		 3D 83 A6 72 
		 A9 7E B1 7B 
		 01 82 73 9A 
		 48 BD E9 C9 
		 84 13 F1 83 
		 E4 7C 00 81 
		 E1 76 31 83 
		 3A 7A 5F 8C 
		 CF 88 21 82 
		 F3 9B 83 C4 
		 17 D3 67 0D 
		 DB 0F DD 59 
		 14 70 71 FD 
		 26 3D D3 45 
		 E6 41 00 00 
		 DC 4C F9 40 
		 07 39 00 00 
		 00 00 00 00 
		 00 00 00 00 
		 3D 70 06 6B 
		 13 7E 84 81 
		 32 76 B7 6A 
		 64 74 AD 72 
		 4F 74 DA 63 
		 4D 7D 00 A3 
		 1A F7 61 95 
		 64 A0 71 0C 
		 28 00 FF 36 
		 F0 11 30 03 
		 00 00 00 0C 
	];
};

