/*
 * nubia overwrite dts
 */


#include "others.dtsi"
#include "camera.dtsi"

#include "nfc.dtsi"
#include "neo-power.dtsi"
#include "display.dtsi"
#include "touch.dtsi"
#include "vibrator.dtsi"
#include "key.dtsi"
#include "sensors.dtsi"
#include "breathlight.dtsi"
#include "fingerprint.dtsi"
