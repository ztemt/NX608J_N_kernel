/* Copyright (c) 2013-2014, The Linux Foundation. All rights reserved.
 *
 * This program is free software; you can redistribute it and/or modify
 * it under the terms of the GNU General Public License version 2 and
 * only version 2 as published by the Free Software Foundation.
 *
 * This program is distributed in the hope that it will be useful,
 * but WITHOUT ANY WARRANTY; without even the implied warranty of
 * MERCHANTABILITY or FITNESS FOR A PARTICULAR PURPOSE.  See the
 * GNU General Public License for more details.
 */

//zte_nx508j_2850mah_averaged_masterslave_dec10th2014


qcom,ztemt-batterydata  {
	qcom,fcc-mah = <5000>;/*zte added*/
	qcom,nom-batt-capacity-mah = <5000>;
	qcom,default-rbatt-mohm = <128>;/*zte added*/
	qcom,max-voltage-uv = <4400000>;
	qcom,rbatt-capacitive-mohm = <50>;/*zte added*/
	qcom,v-cutoff-uv = <3400000>;/*zte added*/
	qcom,chg-term-ua = <200000>;/*zte added*/
	qcom,batt-id-kohm = <10>;
	qcom,battery-beta = <4050>;
	qcom,chg-rslow-comp-c1 = <3464630>;
	qcom,chg-rslow-comp-c2 = <4962378>;
	qcom,chg-rs-to-rslow = <975677>;
	qcom,chg-rslow-comp-thr = <0xA6>;
	qcom,checksum = <0x330B>;
	qcom,gui-version = "PMI8950GUI - 2.0.0.16";
	qcom,battery-type = "ztemt_atl_5000mah";

	qcom,fg-profile-data = [
		 E2 83 EB 7C 
		 3A 81 95 77 
		 5B 83 08 6C 
		 0E 88 F4 8E 
		 4B 82 87 98 
		 69 B6 19 C2 
		 52 14 F3 83 
		 F5 7C 16 81 
		 1C 77 4A 83 
		 C2 71 37 6C 
		 CC 7C 59 82 
		 3C 99 5F BC 
		 E8 C8 58 0C 
		 A3 13 EA 58 
		 14 70 71 FD 
		 E5 34 DD 46 
		 93 41 00 00 
		 FE 47 EB 39 
		 CF 38 00 00 
		 00 00 00 00 
		 00 00 00 00 
		 D5 6B 89 6A 
		 30 5F 21 89 
		 F0 75 25 6B 
		 CD 67 37 79 
		 43 6F 03 63 
		 BF 6C 3D A8 
		 20 42 63 C4 
		 65 A0 71 0C 
		 28 00 FF 36 
		 F0 11 30 03 
		 00 00 00 0C 
	];
};

