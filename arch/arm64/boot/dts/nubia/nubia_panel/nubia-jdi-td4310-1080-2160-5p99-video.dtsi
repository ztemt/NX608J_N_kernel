/* Copyright (c) 2013, The Linux Foundation. All rights reserved.
 *
 * This program is free software; you can redistribute it and/or modify
 * it under the terms of the GNU General Public License version 2 and
 * only version 2 as published by the Free Software Foundation.
 *
 * This program is distributed in the hope that it will be useful,
 * but WITHOUT ANY WARRANTY; without even the implied warranty of
 * MERCHANTABILITY or FITNESS FOR A PARTICULAR PURPOSE.  See the
 * GNU General Public License for more details.
 */

/*---------------------------------------------------------------------------
 * This file is autogenerated file using gcdb parser. Please do not edit it.
 * Update input XML file to add a new entry or update variable in this file
 * VERSION = "1.0"
 *---------------------------------------------------------------------------*/
&mdss_mdp {
	dsi_jdi_td4310_1080_2160_5p99_video: qcom,mdss_dsi_jdi_td4310_1080_2160_5p99_video {
		qcom,mdss-dsi-panel-name = "jdi td4310 1080 2160 5p99 video dsi panel";
		qcom,mdss-dsi-panel-controller = <&mdss_dsi0>;
		qcom,mdss-dsi-panel-type = "dsi_video_mode";
		qcom,mdss-dsi-panel-destination = "display_1";
		qcom,mdss-dsi-panel-framerate = <60>;
		qcom,mdss-dsi-virtual-channel-id = <0>;
		qcom,mdss-dsi-stream = <0>;
		qcom,mdss-pan-physical-width-dimension = <68>;
		qcom,mdss-pan-physical-height-dimension = <136>;
		qcom,mdss-dsi-panel-width = <1080>;
		qcom,mdss-dsi-panel-height = <2160>;
		qcom,mdss-dsi-h-front-porch = <122>;
		qcom,mdss-dsi-h-back-porch = <72>;
		qcom,mdss-dsi-h-pulse-width = <50>;
		qcom,mdss-dsi-h-sync-skew = <0>;
		qcom,mdss-dsi-v-back-porch = <5>;
		qcom,mdss-dsi-v-front-porch = <10>;
		qcom,mdss-dsi-v-pulse-width = <5>;
		qcom,mdss-dsi-h-left-border = <0>;
		qcom,mdss-dsi-h-right-border = <0>;
		qcom,mdss-dsi-v-top-border = <0>;
		qcom,mdss-dsi-v-bottom-border = <0>;
		qcom,mdss-dsi-bpp = <24>;
		qcom,mdss-dsi-color-order = "rgb_swap_rgb";
		qcom,mdss-dsi-underflow-color = <0xff>;
		qcom,mdss-dsi-border-color = <0>;
		qcom,mdss-dsi-on-command = [
			15 01 00 00 00 00 02 35 00
			15 01 00 00 00 00 02 36 00
			39 01 00 00 00 00 03 44 03 e8
			15 01 00 00 00 00 02 53 24
			15 01 00 00 00 00 02 55 00
			05 01 00 00 64 00 01 11
			15 01 00 00 00 00 02 B0 04
			39 01 00 00 00 00 27
				C7 05 23 33 46 56 60 78 87 94
				9F 51 5C 6A 7D 87 94 A5 B1 BF
				05 23 33 46 56 60 78 87 94 9F
				51 5C 6A 7D 87 94 A5 B1 BF
			39 01 00 00 00 00 38
				C8 01 00 00 03 04 BB 00 00 02
				FE 02 FC 00 00 02 00 FF D8 00
				00 00 00 00 FC 00 00 00 00 00
				FC 00 00 00 00 00 FC 00 00 00
				00 00 FC 00 00 00 00 00 FC 00
				00 00 00 00 FC 00
			39 01 00 00 00 00 14 C9
				00 00 00 00 00 00 00 00 00 00
				00 00 00 00 00 00 00 00 00
			15 01 00 00 00 00 02 B0 03
			05 01 00 00 14 00 01 29
			15 01 00 00 00 00 02 51 ff];
		qcom,mdss-dsi-on-command-es2 = [
			15 01 00 00 00 00 02 35 00
			15 01 00 00 00 00 02 36 00
			39 01 00 00 00 00 03 44 03 e8
			15 01 00 00 00 00 02 53 24
			15 01 00 00 00 00 02 55 00
			05 01 00 00 64 00 01 11
			15 01 00 00 00 00 02 B0 04
			39 01 00 00 00 00 27
				C7 05 23 33 46 56 60 78 87 94
				9F 51 5C 6A 7D 87 94 A5 B1 BF
				05 23 33 46 56 60 78 87 94 9F
				51 5C 6A 7D 87 94 A5 B1 BF
			39 01 00 00 00 00 38
				C8 01 00 03 04 04 EF 00 00 04
				FF FE FC 00 00 04 FE FA FC 00
				00 00 00 00 FC 00 00 00 00 00
				FC 00 00 00 00 00 FC 00 00 00
				00 00 FC 00 00 00 00 00 FC 00
				00 00 00 00 FC 00
			39 01 00 00 00 00 14
				C9 00 00 00 00 00 00 00 00 00
				00 00 00 00 00 00 00 00 00 00
			15 01 00 00 00 00 02 B0 03
			05 01 00 00 14 00 01 29
			15 01 00 00 00 00 02 51 ff];
               qcom,mdss-dsi-on-command-pp = [
                        15 01 00 00 00 00 02 35 00
                        15 01 00 00 00 00 02 36 00
                        39 01 00 00 00 00 03 44 03 e8
                        15 01 00 00 00 00 02 53 24
                        15 01 00 00 00 00 02 55 00
                        05 01 00 00 64 00 01 11
                        15 01 00 00 00 00 02 B0 04
			39 01 00 00 00 00 27
				C7 05 25 35 48 57 62 79 89 95
				A0 52 5D 6A 7D 87 94 A5 B1 BF
				05 25 35 48 57 62 79 89 95 A0
				52 5D 6A 7D 87 94 A5 B1 BF
			39 01 00 00 00 00 38
				C8 01 00 01 03 03 DC 00 00 02
				FF FF E8 00 00 02 FE F7 FC 00
				00 00 00 00 FC 00 00 00 00 00
				FC 00 00 00 00 00 FC 00 00 00
				00 00 FC 00 00 00 00 00 FC 00
				00 00 00 00 FC 00
			39 01 00 00 00 00 14
				C9 00 00 00 00 00 00 00 00 00
				00 00 00 00 00 00 00 00 00 00
                        15 01 00 00 00 00 02 B0 03
                        05 01 00 00 14 00 01 29
                        15 01 00 00 00 00 02 51 ff];

		qcom,mdss-dsi-off-command = [
			05 01 00 00 14 00 01 28
			05 01 00 00 78 00 01 10];
		qcom,mdss-dsi-on-command-state = "dsi_lp_mode";
		qcom,mdss-dsi-off-command-state = "dsi_hs_mode";
		/*cabc start*/
		nubia,mdss-dsi-cabc-command-off = [15 01 00 00 00 00 02 55 00];
		nubia,mdss-dsi-cabc-command-level1 = [15 01 00 00 00 00 02 55 01];
		nubia,mdss-dsi-cabc-command-level2 = [15 01 00 00 00 00 02 55 02];
		nubia,mdss-dsi-cabc-command-level3 = [15 01 00 00 00 00 02 55 03];
		nubia,mdss-dsi-cabc-command-state = "dsi_hs_mode";
		/*cabc end*/


		nubia,mdss-dsi-ce-command-std = [
						15 01 00 00 00 00 02 B0 00
						39 01 00 00 00 00 2C CA
							1C FC FC FC 00 00 00 00 00 00
							00 00 00 00 00 00 00 00 00 00
							00 00 00 00 00 00 00 00 00 00
							00 00 00 00 00 00 00 00 00 00
							00 00 00
						15 01 00 00 00 00 02 B0 03];

		nubia,mdss-dsi-ce-command-soft = [15 01 00 00 00 00 02 B0 00
						39 01 00 00 00 00 2C CA
							1D FC FC FC 00 D1 D1 A8 00 A8
							CE CE 00 9C 00 00 00 BA 00 00
							00 9C FF 9F 83 FF 9F 83 7D 00
							00 00 00 00 00 00 00 00 00 00
							00 00 00
						15 01 00 00 00 00 02 B0 03];

		nubia,mdss-dsi-ce-command-glow = [15 01 00 00 00 00 02 B0 00
						39 01 00 00 00 00 2C CA
							3D FC FC FC 00 D5 D5 AA 00 AA
							D1 D1 00 99 00 00 00 B4 00 00
							00 99 FF 9F 83 FF 9F 83 7D 00
							00 00 00 00 00 00 00 00 00 00
							00 00 00
						15 01 00 00 00 00 02 B0 03];
		qcom,mdss-dsi-h-sync-pulse = <0>;
		qcom,mdss-dsi-traffic-mode = "burst_mode";
		qcom,mdss-dsi-lane-map = "lane_map_0123";
		qcom,mdss-dsi-bllp-eof-power-mode;
		qcom,mdss-dsi-bllp-power-mode;
		qcom,mdss-dsi-lane-0-state;
		qcom,mdss-dsi-lane-1-state;
		qcom,mdss-dsi-lane-2-state;
		qcom,mdss-dsi-lane-3-state;
		qcom,mdss-dsi-panel-timings-phy-v2 = [
			25 20 09 0a 06 03 04 a0
			25 20 09 0a 06 03 04 a0
			25 20 09 0a 06 03 04 a0
			25 20 09 0a 06 03 04 a0
			25 1f 09 0a 06 03 04 a0];
		qcom,mdss-dsi-t-clk-post = <0x0e>;
		qcom,mdss-dsi-t-clk-pre = <0x36>;
		qcom,mdss-dsi-bl-min-level = <1>;
		qcom,mdss-dsi-bl-max-level = <3020>;
		qcom,mdss-brightness-max-level = <4095>;
		qcom,mdss-dsi-dma-trigger = "trigger_sw";
		qcom,mdss-dsi-mdp-trigger = "none";
		qcom,mdss-dsi-bl-pmic-control-type = "bl_ctrl_wled";
		qcom,mdss-dsi-reset-sequence = <0 11>, <1 21>;
		qcom,panel-supply-entries = <&nubia_dsi_panel_pwr_supply>;

		qcom,esd-check-enabled;
		qcom,mdss-dsi-panel-status-command = [06 01 00 01 05 00 02 0A 08];
		qcom,mdss-dsi-panel-status-command-state = "dsi_lp_mode";
		qcom,mdss-dsi-panel-status-check-mode = "reg_read";
		qcom,mdss-dsi-panel-status-read-length = <1>;
		qcom,mdss-dsi-panel-max-error-count = <1>;
		qcom,mdss-dsi-panel-status-value = <0x1C>;
	};
};
